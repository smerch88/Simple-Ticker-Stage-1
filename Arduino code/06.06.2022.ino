#include <Arduino.h>
#include <Stepper.h>
#include "SPI.h"
#include "Adafruit_GFX.h"
#include "Adafruit_ST7735.h"
#include <ArduinoJson.h>
#include <WiFiManager.h>
#include "GyverButton.h"
#include <WebSocketsClient.h>
#include <Hash.h>

#define TFT_CS    4     // TFT CS  pin is connected to NodeMCU pin D2
#define TFT_RST   0     // TFT RST pin is connected to NodeMCU pin D3
#define TFT_DC    2     // TFT DC  pin is connected to NodeMCU pin D4
#define BUT       12     // Button pin

// initialize ILI9341 TFT library with hardware SPI module
// SCK (CLK) ---> NodeMCU pin D5 (GPIO14)
// MOSI(DIN) ---> NodeMCU pin D7 (GPIO13)
Adafruit_ST7735 tft = Adafruit_ST7735(TFT_CS,  TFT_DC, TFT_RST);

// All asset logos must be 48x48
#define LOGO_WIDTH 48
#define LOGO_HEIGHT 48

// Struct to store an asset
struct asset { 
   String assetName;
   String url;
   String url_unsub;
   const unsigned char logo [288];
};

String btc_rate;
int Asset_number, prev_Asset_number;
String pch; //no blink mode_nmbrger
int i = NULL;
int ind1;
String rem_asset;
int t;

// Declare all assests used
// To add a new asset
//  1: Add a new setup similar to one shown in the examples
//  2: Update the name and isCrypto flag for the asset (either CRYPTO or STOCK)
//  3: Find the api.cryptonator.com or finnhub.io api url for the asset
//  4: Create a 48x48 bitmap logo for the asset using http://javl.github.io/image2cpp/
asset assets[] = {
    // Doge setup
    {"Doge",
     "{\"method\": \"SUBSCRIBE\",\"params\":[\"dogeusdt@trade\"],\"id\": 1}",
     "{\"method\": \"UNSUBSCRIBE\",\"params\":[\"dogeusdt@trade\"],\"id\": 312}",
      {0x03, 0x00, 0x00, 0x01, 0xe0, 0x00, 0x07, 0xc0, 0x00, 0x03, 0xf8, 0x00, 0x0f, 0xe0, 0x00, 0x07, 
      0xf8, 0x00, 0x0f, 0xe0, 0x00, 0x0f, 0xfc, 0x00, 0x1f, 0xf0, 0x00, 0x3f, 0x3c, 0x00, 0x1e, 0xf8, 
      0x00, 0x7e, 0x38, 0x00, 0x1e, 0x78, 0x00, 0xfc, 0x38, 0x00, 0x1c, 0x3c, 0x03, 0xff, 0x38, 0x00, 
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      0xff, 0xff, 0xff, 0x00, 0x00, 0x00, 0xff, 0xff, 0xfc, 0x00, 0x00, 0x00, 0x03, 0xff, 0xc0, 0x00}
    },
    // BTC setup
    {"BTC",
      "{\"method\": \"SUBSCRIBE\",\"params\":[\"btcusdt@trade\"],\"id\": 1}",
      "{\"method\": \"UNSUBSCRIBE\",\"params\":[\"btcusdt@trade\"],\"id\": 312}",
      {0x00, 0x00, 0x0f, 0xf0, 0x00, 0x00, 0x00, 0x00, 0xff, 0xff, 0x00, 0x00, 0x00, 0x03, 0xff, 0xff, 
      0xc0, 0x00, 0x00, 0x0f, 0xff, 0xff, 0xf0, 0x00, 0x00, 0x3f, 0xff, 0xff, 0xfc, 0x00, 0x00, 0x7f, 
      0xff, 0xff, 0xfe, 0x00, 0x00, 0xff, 0xff, 0xff, 0xff, 0x00, 0x01, 0xff, 0xff, 0xff, 0xff, 0x80, 
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      0xff, 0xff, 0xe0, 0x00, 0x00, 0x00, 0xff, 0xff, 0x00, 0x00, 0x00, 0x00, 0x1f, 0xf8, 0x00, 0x00}
    },
    // ETH setup
    {"ETH",
      "{\"method\": \"SUBSCRIBE\",\"params\":[\"ethusdt@trade\"],\"id\": 1}",
      "{\"method\": \"UNSUBSCRIBE\",\"params\":[\"ethusdt@trade\"],\"id\": 312}",
      {0x00, 0x00, 0x07, 0xf0, 0x00, 0x00, 0x00, 0x00, 0xff, 0xff, 0x00, 0x00, 0x00, 0x03, 0xff, 0xff, 
      0xc0, 0x00, 0x00, 0x0f, 0xfe, 0xff, 0xf0, 0x00, 0x00, 0x1f, 0xfc, 0x7f, 0xfc, 0x00, 0x00, 0x7f, 
      0xfc, 0x7f, 0xfe, 0x00, 0x00, 0xff, 0xf8, 0x3f, 0xff, 0x00, 0x01, 0xff, 0xf0, 0x1f, 0xff, 0x80, 
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      0xff, 0xff, 0xe0, 0x00, 0x00, 0x00, 0xff, 0xff, 0x80, 0x00, 0x00, 0x00, 0x1f, 0xf0, 0x00, 0x00}
    },
    // XLM setup
    {"Stellar",
      "{\"method\": \"SUBSCRIBE\",\"params\":[\"xlmusdt@trade\"],\"id\": 1}",
      "{\"method\": \"UNSUBSCRIBE\",\"params\":[\"xlmusdt@trade\"],\"id\": 312}",
     {0x00, 0x00, 0x00, 0x00, 0x00, 0x00, 0x00, 0x00, 0x00, 0x00, 0x00, 0x00, 0x00, 0x00, 0x00, 0x00, 
      0x00, 0x00, 0x00, 0x00, 0x03, 0xc0, 0x00, 0x00, 0x00, 0x00, 0x3f, 0xfc, 0x00, 0x00, 0x00, 0x00, 
      0xff, 0xff, 0x00, 0x00, 0x00, 0x03, 0xff, 0xff, 0xc0, 0x03, 0x00, 0x0f, 0xfc, 0x3f, 0xf0, 0x0f, 
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      0x00, 0x00, 0x00, 0x00, 0x00, 0x00, 0x00, 0x00, 0x00, 0x00, 0x00, 0x00, 0x00, 0x00, 0x00, 0x00}
    }
};

WebSocketsClient webSocket;
GButton butt1(BUT);     //create button object
WiFiClient client;

void display_crypto(){
    if (Asset_number!=prev_Asset_number && millis()-t>2000){
          webSocket.disconnect();                             // the way to break the stream to reconnect with new settings
    prev_Asset_number=Asset_number;
    }
  if (pch != btc_rate){                                       // checking if crypto rate have changed in order to reduce refresh rate
    if (rem_asset == assets[Asset_number].assetName){         // checking if Asset number have changed in order to reduce refresh rate of logo and title       
    tft.fillRect(0, 50, 160, 20, ST7735_BLACK);               // fills only field of changing data
    tft.setTextColor(ST7735_WHITE);
    tft.setCursor(10,10);
    tft.setTextSize(2);
    tft.println(assets[Asset_number].assetName+"/USD");
    rem_asset = assets[Asset_number].assetName;               // remember if Asset title was changed (could use Asset number instead) 
    tft.setCursor(10,50);
        if (btc_rate == "sult\":nul" || millis()-t<2000){                        // kind of wrong request
          tft.setTextColor(ST7735_WHITE);
          tft.println("");
        }
        else tft.println(btc_rate);
        tft.drawBitmap(75, 75, assets[Asset_number].logo, 48, 48, ST7735_ORANGE);
        pch = btc_rate;
  }
    else{                                                     // this part exequtes if Asset number was changed after button1 was hit
    tft.fillScreen(ST7735_BLACK);                             
    tft.setTextColor(ST7735_WHITE);
    tft.setTextSize(2);
    tft.setCursor(10,10);
    tft.println(assets[Asset_number].assetName+"/USD");
    rem_asset = assets[Asset_number].assetName;
    tft.setTextSize(2);
    tft.setCursor(10,50);
        if (btc_rate == "sult\":nul" || millis()-t<2000){                        // kind of wrong request
          tft.setTextColor(ST7735_WHITE);
          tft.println("");
        }
        else tft.println(btc_rate);{
        tft.drawBitmap(75, 75, assets[Asset_number].logo, 48, 48, ST7735_ORANGE);
        pch = btc_rate;
        }
     }      
  }
}

void setup() {
  Serial.begin(115200);

  //Serial.setDebugOutput(true);
  Serial.setDebugOutput(true);

  for(uint8_t t = 4; t > 0; t--) {
  //  Serial.println("[SETUP] BOOT WAIT...\n");
    Serial.flush();
    delay(1000);
  }
    tft.initR(INITR_BLACKTAB);  // You will need to do this in every sketch
    tft.fillScreen(ST7735_BLACK); 
    ////tft print function!
    tft.setRotation(3);
    tft.setTextColor(ST7735_WHITE);
    tft.setTextSize(0);
    tft.setCursor(10,80);
    tft.println("Starting device...!");  
    delay(1000);
    // put your setup code here, to run once:
    Serial.begin(115200);
    
    //WiFiManager, Local intialization. Once its business is done, there is no need to keep it around
    WiFiManager wm;

    // reset settings - wipe stored credentials for testing
    // these are stored by the esp library
    //wm.resetSettings();

    // Automatically connect using saved credentials,
    // if connection fails, it starts an access point with the specified name ( "AutoConnectAP"),
    // if empty will auto generate SSID, if password is blank it will be anonymous AP (wm.autoConnect())
    // then goes into a blocking loop awaiting configuration and will return success result

    bool res;
    // res = wm.autoConnect(); // auto generated AP name from chipid
    res = wm.autoConnect("AutoConnectAP"); // anonymous ap
    // res = wm.autoConnect("AutoConnectAP","password"); // password protected ap

    if(!res) {
     //   Serial.println("Failed to connect");
        // ESP.restart();
    } 
    else {
        //if you get here you have connected to the WiFi    
      //  Serial.println("connected...yeey :)");
    }

  tft.fillScreen(ST7735_BLACK);
  tft.setTextSize(1);
  tft.setTextColor(ST7735_WHITE);
  tft.setCursor(10,80);
  tft.println("Connecting to WiFi...");
  delay(1000);

  butt1.setDebounce(50);        // настройка антидребезга (по умолчанию 80 мс)
  butt1.setTimeout(300);        // настройка таймаута на удержание (по умолчанию 500 мс)
    // HIGH_PULL - кнопка подключена к GND, пин подтянут к VCC (PIN --- КНОПКА --- GND)
    // LOW_PULL  - кнопка подключена к VCC, пин подтянут к GND
  butt1.setType(LOW_PULL);
    // NORM_OPEN - нормально-разомкнутая кнопка
    // NORM_CLOSE - нормально-замкнутая кнопка
  butt1.setDirection(NORM_OPEN);

    WiFi.mode(WIFI_STA); // explicitly set mode, esp defaults to STA+AP

  // server address, port and URL
  webSocket.beginSSL("stream.binance.com", 9443, "/ws/btcusdt");

  // event handler
  webSocket.onEvent(webSocketEvent);

  // try ever 5000 again if connection has failed
  webSocket.setReconnectInterval(100);
  
  // start heartbeat (optional)
  // ping server every 15000 ms
  // expect pong from server within 3000 ms
  // consider connection disconnected if pong is not received 2 times
  webSocket.enableHeartbeat(15000, 1000, 2);

  tft.fillScreen(ST7735_BLACK);
}

void webSocketEvent(WStype_t type, uint8_t * payload, size_t length) {

  switch(type) {
    case WStype_DISCONNECTED:
      Serial.println("[WSc] Disconnected!\n");
      Serial.print(String((char *)payload));
      tft.setCursor(10,50);
      tft.println("Loading...");
      break;
    case WStype_CONNECTED: {
      Serial.println("[WSc] Connected to url:\n");
      //Serial.print(payload);

      // send message to server when Connected   
      webSocket.sendTXT(assets[Asset_number].url);                      // sending request to binance, instructions: https://github.com/binance/binance-spot-api-docs/blob/master/rest-api.md
      Serial.println(assets[Asset_number].url);                         // request printed to serial
    }
      break;
    case WStype_TEXT:{
     // Serial.println("[WSc] get text: \n");
      //Serial.println(String((char *)payload));
      String str = (char*)payload;                                      // converting into String
      ind1 = str.indexOf("\"p\":\"");                                   // part of String where starts the price section
      btc_rate = str.substring(ind1+5, ind1+14);                        // part of price, including 9 symbols
      //Serial.println(btc_rate);
      break;
      }
    case WStype_BIN:
      //Serial.println("[WSc] get binary length: %u\n", length);
      hexdump(payload, length);

      // send data to server
      // webSocket.sendBIN(payload, length);
      break;
    case WStype_PING:
        // pong will be send automatically
      //  Serial.println("[WSc] get ping\n");
        break;
    case WStype_PONG:
        // answer to a ping we send
      //  Serial.println("[WSc] get pong\n");
        break;
    }

}

int MOD() {                                             // function for button1
   butt1.tick();                                        // обязательная функция отработки кнопки. Должна постоянно опрашиваться
   if (butt1.isPress()) {
  t=millis();
    Serial.println("Press");                          // checking if button was released 
      if (Asset_number<=2) {
        Asset_number++;
        }                              // thus mode chosing 
      else (Asset_number=0);
    Serial.println(Asset_number);
    pch="";                           // was helping to reload the screen but seems not working ???
    tft.fillScreen(ST7735_BLACK);     // fully clear screen only after button released
    btc_rate = "Loading...";          // if new value not set, showing info from response about finishing the stream, etc
  }
  return (Asset_number);              // changes the asset number (link, logo, title)
}

void loop() {
  //delay(500);                                               // could be addeded as a way to reduce refresh rate for eye comfort
  webSocket.loop();                                           // necesarry function for webSocket
  //Serial.println("next loop");
  MOD();
  display_crypto();
  butt1.tick(); 
}
